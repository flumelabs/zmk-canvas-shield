## boards/shields/canvas/Kconfig.defconfig
```kconfig
if SHIELD_CANVAS_LEFT

config ZMK_KEYBOARD_NAME
    default "Canvas"

config ZMK_SPLIT_ROLE_CENTRAL
    default y

endif

if SHIELD_CANVAS_LEFT || SHIELD_CANVAS_RIGHT

config ZMK_SPLIT
    default y

config I2C
    default y

endif
```

## boards/shields/canvas/Kconfig.shield
```kconfig
config SHIELD_CANVAS_LEFT
    def_bool $(shields_list_contains,canvas_left)

config SHIELD_CANVAS_RIGHT
    def_bool $(shields_list_contains,canvas_right)
```

## config/west.yml
```yaml
manifest:
  remotes:
    - name: zmkfirmware
      url-base: https://github.com/zmkfirmware
    - name: badjeff
      url-base: https://github.com/badjeff
  projects:
    - name: zmk
      remote: zmkfirmware
      revision: v0.1
      import: app/west.yml
    - name: zmk-output-behavior-listener
      remote: badjeff
      revision: d6f2f4c
    - name: zmk-split-peripheral-output-relay
      remote: badjeff
      revision: 014b549
    - name: zmk-drv2605-driver
      remote: badjeff
      revision: 81a386a
  self:
    path: config
```
